## prj.conf
```kconfig
#General
CONFIG_NO_OPTIMIZATIONS=y
CONFIG_HEAP_MEM_POOL_SIZE=16384
CONFIG_STDOUT_CONSOLE=y
CONFIG_GPIO=y

# USB
CONFIG_USB=y
CONFIG_USB_DEVICE_STACK=y
CONFIG_USB_DEVICE_MANUFACTURER="Nordic Semiconductor ASA"
CONFIG_USB_DEVICE_PRODUCT="nRF52 UART"
CONFIG_USB_DEVICE_VID=0x1915
CONFIG_USB_DEVICE_PID=0x5200
CONFIG_USB_CDC_ACM=y
CONFIG_USB_COMPOSITE_DEVICE=y
CONFIG_LOG=y
CONFIG_LOG_BACKEND_RTT=y
CONFIG_LOG_BACKEND_RTT_MODE_DROP=y

# UART
CONFIG_SERIAL=y
CONFIG_UART_INTERRUPT_DRIVEN=y
CONFIG_UART_LINE_CTRL=y
```

## src/main.c
```c
/*
 * Copyright (c) 2018 Nordic Semiconductor
 *
 * SPDX-License-Identifier: Apache-2.0
 */

#include <stdio.h>
#include <string.h>
#include <device.h>
#include <uart.h>
#include <zephyr.h>
#include <stdio.h>
#include <misc/printk.h>
#include <console.h>

#define THREAD_STACKSIZE		1024
#define UART_BUF_SIZE			68
#define THREAD_PRIORITY			7

static struct k_sem usb_tx_sem;
static struct k_sem uart_tx_sem;
static K_FIFO_DEFINE(usb_tx_fifo);
static K_FIFO_DEFINE(uart_tx_fifo);

static struct device *usb_dev;
static struct device *uart_dev;

struct uart_data {
	void *fifo_reserved;
	u8_t buffer[UART_BUF_SIZE];
	u16_t len;
};

static void usb_cb(struct device *dev)
{
	uart_irq_update(dev);

	if (uart_irq_rx_ready(dev)) {
		u32_t data_length;
		static struct uart_data *rx;

		if (!rx) {
			rx = k_malloc(sizeof(*rx));
			if (rx) {
				rx->len = 0;
			} else {
				printk("Not able to allocate buffer\n");
				return;
			}
		}

		data_length = uart_fifo_read(dev, &rx->buffer[rx->len],
					     UART_BUF_SIZE - rx->len);
		rx->len += data_length;

		if (rx->len > 0) {
			k_fifo_put(&uart_tx_fifo, rx);
			rx = NULL;
			k_sem_give(&uart_tx_sem);
		}
	}

	if (uart_irq_tx_ready(dev)) {
		struct uart_data *buf =
			k_fifo_get(&usb_tx_fifo, K_NO_WAIT);
		u16_t written = 0;

		/* Nothing in the FIFO, nothing to send */
		if (!buf) {
			uart_irq_tx_disable(dev);
			return;
		}

		while (buf->len > written) {
			written += uart_fifo_fill(dev,
						  &buf->buffer[written],
						  buf->len - written);
		}

		while (!uart_irq_tx_complete(dev)) {
			/* Wait for the last byte to get
			 * shifted out of the module
			 */
		}

		if (k_fifo_is_empty(&usb_tx_fifo)) {
			uart_irq_tx_disable(dev);
		}

		k_free(buf);
	}
}

void usb_tx_thread(void)
{
	while (1) {
		k_sem_take(&usb_tx_sem, K_FOREVER);
		uart_irq_tx_enable(usb_dev);
	}
}

void uart_tx_thread(void)
{
	while (1) {
		k_sem_take(&uart_tx_sem, K_FOREVER);
		uart_irq_tx_enable(uart_dev);

	}
}

static void uart_cb(struct device *dev)
{
	static struct uart_data *rx;

	uart_irq_update(dev);

	if (uart_irq_rx_ready(dev)) {
		int data_length;

		if (!rx) {
			rx = k_malloc(sizeof(*rx));
			if (rx) {
				rx->len = 0;
			} else {
				printk("Not able to allocate UART receive buffer\n");
				return;
			}
		}

		data_length = uart_fifo_read(dev, &rx->buffer[rx->len],
					     UART_BUF_SIZE - rx->len);
		rx->len += data_length;

		if (rx->len > 0) {
			if ((rx->len == UART_BUF_SIZE) ||
			   (rx->buffer[rx->len - 1] == '\n') ||
			   (rx->buffer[rx->len - 1] == '\r')) {
				k_fifo_put(&usb_tx_fifo, rx);
				rx = NULL;
				k_sem_give(&usb_tx_sem);
			}
		}
	}

	if (uart_irq_tx_ready(dev)) {
		struct uart_data *buf =
			k_fifo_get(&uart_tx_fifo, K_NO_WAIT);
		u16_t written = 0;

		/* Nothing in the FIFO, nothing to send */
		if (!buf) {
			uart_irq_tx_disable(dev);
			return;
		}

		while (buf->len > written) {
			written += uart_fifo_fill(dev,
						  &buf->buffer[written],
						  buf->len - written);
		}

		while (!uart_irq_tx_complete(dev)) {
			/* Wait for the last byte to get
			 * shifted out of the module
			 */
		}

		if (k_fifo_is_empty(&uart_tx_fifo)) {
			uart_irq_tx_disable(dev);
		}

		k_free(buf);
	}
}

static int init_uart(void)
{
	uart_dev = device_get_binding("UART_1");
	if (!uart_dev) {
		return -ENXIO;
	}

	uart_irq_callback_set(uart_dev, uart_cb);
	uart_irq_rx_enable(uart_dev);

	return 0;
}

void main(void)
{
	u32_t baudrate, dtr = 0;
	int err;

	k_sem_init(&usb_tx_sem, 0, 1);
	k_sem_init(&uart_tx_sem, 0, 1);

	/* For unknown reasons, we have to sleep ~200 ms here
	 * for the USB to be recognized properly by Windows. We loose early
	 * log information on power cycle because of this.
	 * TODO: Investiate and fix this bug.
	 */
	k_sleep(1);
	init_uart();
	usb_dev = device_get_binding(CONFIG_CDC_ACM_PORT_NAME);
	if (!usb_dev) {
		printk("CDC ACM device not found\n");
		return;
	}

	printk("Wait for DTR\n");

	while (1) {
		uart_line_ctrl_get(usb_dev, LINE_CTRL_DTR, &dtr);

		if (dtr) {
			break;
		}
	}

	printk("DTR set\n");

	/* They are optional, we use them to test the interrupt endpoint */
	err = uart_line_ctrl_set(usb_dev, LINE_CTRL_DCD, 1);
	if (err)
		printf("Failed to set DCD, err code %d\n", err);

	err = uart_line_ctrl_set(usb_dev, LINE_CTRL_DSR, 1);
	if (err)
		printf("Failed to set DSR, err code %d\n", err);

	/* Wait 1 sec for the host to do all settings */
	k_busy_wait(1000000);

	err = uart_line_ctrl_get(usb_dev, LINE_CTRL_BAUD_RATE, &baudrate);
	if (err)
		printf("Failed to get baudrate, err code %d\n", err);
	else
		printf("Baudrate detected: %d\n", baudrate);

	uart_irq_callback_set(usb_dev, usb_cb);
	uart_irq_rx_enable(usb_dev);
	printk("Logs are now forwarded from nRF91 to USB\n");
}
		
K_THREAD_DEFINE(usb_tx_thread_id, THREAD_STACKSIZE, usb_tx_thread,
		NULL, NULL, NULL, THREAD_PRIORITY, 0, K_NO_WAIT);

K_THREAD_DEFINE(uart_tx_thread_id, THREAD_STACKSIZE, uart_tx_thread,
		NULL, NULL, NULL, THREAD_PRIORITY, 0, K_NO_WAIT);
```
