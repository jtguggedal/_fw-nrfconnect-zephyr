## CMakeLists.txt
```
cmake_minimum_required(VERSION 3.13.1)
include(../../../../nrf/cmake/boilerplate.cmake NO_POLICY_SCOPE)
include($ENV{ZEPHYR_BASE}/cmake/app/boilerplate.cmake NO_POLICY_SCOPE)
project(bh1749)

FILE(GLOB app_sources src/*.c)
target_sources(app PRIVATE ${app_sources})
```

## prj.conf
```kconfig
CONFIG_PRINTK=y
CONFIG_GPIO=y
CONFIG_I2C=y
CONFIG_PRINTK=y
CONFIG_SENSOR=y

CONFIG_LOG=y
# CONFIG_LOG_IMMEDIATE=y
CONFIG_SENSOR_LOG_LEVEL_DBG=y
CONFIG_I2C_LOG_LEVEL_INF=y

CONFIG_BH1749=y
CONFIG_BH1749_TRIGGER_GLOBAL_THREAD=n
CONFIG_DEVICE_POWER_MANAGEMENT=n
```

## src/main.c
```c
/*
 * Copyright (c) 2017 Intel Corporation
 * Copyright (c) 2018 Phytec Messtechnik GmbH
 *
 * SPDX-License-Identifier: Apache-2.0
 */

#include <zephyr.h>
#include <sensor.h>
#include <device.h>
#include <stdio.h>
#include <misc/printk.h>

#ifdef CONFIG_BH1749_TRIGGER
K_SEM_DEFINE(sem, 0, 1);

static void trigger_handler(struct device *dev, struct sensor_trigger *trigger)
{
	ARG_UNUSED(dev);
	ARG_UNUSED(trigger);

	k_sem_give(&sem);
}
#endif

void main(void)
{
	struct device *dev;
	struct sensor_value intensity, pdata;

	printk("BH1749 sample application\n");
	dev = device_get_binding(DT_ROHM_BH1749_0_LABEL);
	if (!dev) {
		printk("sensor: device not found.\n");
		return;
	}

#ifdef CONFIG_BH1749_TRIGGER
	struct sensor_trigger trig = {
		.type = SENSOR_TRIG_DATA_READY,
		.chan = SENSOR_CHAN_ALL,
	};

	if (sensor_trigger_set(dev, &trig, trigger_handler)) {
		printk("Could not set trigger\n");
		return;
	}
#endif

	while (true) {
#ifdef CONFIG_BH1749_TRIGGER
		printk("Waiting for a threshold event\n");
		k_sem_take(&sem, K_FOREVER);
#else
		k_sleep(5000);
#endif
		if (sensor_sample_fetch(dev)) {
			printk("Could not fetch sample\n");
		}

		sensor_channel_get(dev, SENSOR_CHAN_RED, &intensity);

		printk("ambient light intensity %d\n",
		       intensity.val1);

#ifdef CONFIG_DEVICE_POWER_MANAGEMENT
		u32_t p_state;

		p_state = DEVICE_PM_LOW_POWER_STATE;
		device_set_power_state(dev, p_state);
		printk("set low power state for 2s\n");
		k_sleep(2000);
		p_state = DEVICE_PM_ACTIVE_STATE;
		device_set_power_state(dev, p_state);
#endif
	}
}
```
