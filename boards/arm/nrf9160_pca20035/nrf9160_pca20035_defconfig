## boards/arm/nrf9160_pca20035/nrf9160_pca20035_defconfig
```kconfig
CONFIG_ARM=y
CONFIG_SOC_FAMILY_NRF=y
CONFIG_SOC_SERIES_NRF91X=y
CONFIG_SOC_NRF9160_XXAA=y
CONFIG_BOARD_NRF9160_PCA20035=y

# Enable MPU
CONFIG_ARM_MPU=y

# Enable TrustZone-M
CONFIG_ARM_TRUSTZONE_M=y

# Enable GPIO
CONFIG_GPIO=y

# Enable RTT backend
CONFIG_CONSOLE=y
CONFIG_USE_SEGGER_RTT=y
CONFIG_RTT_CONSOLE=y

# Enable I2C
CONFIG_I2C=y
CONFIG_HAS_NRFX=y
CONFIG_I2C_NRFX=y
CONFIG_I2C_2=y
CONFIG_I2C_2_NRF_TWIM=y

# Network
CONFIG_NETWORKING=y
CONFIG_NET_SOCKETS=y
CONFIG_NET_SOCKETS_OFFLOAD=y
CONFIG_TEST_RANDOM_GENERATOR=y

# additional board options
# CONFIG_GPIO_AS_PINRESET=y
```

## drivers/sensor/bh1749/Kconfig
```kconfig
#
#  Copyright (c) 2019 Nordic Semiconductor ASA
#
#  SPDX-License-Identifier: Apache-2.0
#

menuconfig BH1749
	bool "BH1749 Sensor"
	depends on I2C && HAS_DTS_I2C && HAS_DTS_GPIO && SENSOR
	help
	  Enable driver for BH1749 sensors.

if BH1749

config CONFIG_BH1749_TRIGGER
	bool "Trigger for BH1749"

choice
	prompt "Trigger mode"
	default BH1749_TRIGGER_NONE
	help
	  Specify the type of triggering used by the driver.

config BH1749_TRIGGER_NONE
	bool "No trigger"

config BH1749_TRIGGER_GLOBAL_THREAD
	bool "Use system workqueue"
	depends on GPIO
	select BH1749_TRIGGER

endchoice

config BH1749_TRIGGER
	bool

endif # BH1749
```
